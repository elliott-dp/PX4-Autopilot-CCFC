## src/modules/cc_safety_monitor/Kconfig
```kconfig
menuconfig MODULES_CC_SAFETY_MONITOR
	bool "cc_safety_monitor"
	default n
	---help---
		Enable support for cc_safety_monitor — the CCFC fork's deterministic
		companion safety policy core (spec §4.5). Consumes validated
		cc_health_report, runs the companion state machine + policy table, and
		issues at most one conservative Hold/Land/RTL / exit-Offboard
		vehicle_command per state transition. Parameterized via CC_MON_*.
```

## src/modules/cc_telemetry_publisher/Kconfig
```kconfig
menuconfig MODULES_CC_TELEMETRY_PUBLISHER
	bool "cc_telemetry_publisher"
	default n
	---help---
		Enable support for cc_telemetry_publisher — the CCFC fork's
		companion-computer telemetry curator (deterministic uORB field
		selection + rate control feeding the MAVLink CC_* streams).
```
